## board/lowrisc/mocha/Kconfig
```kconfig
if TARGET_LOWRISC_MOCHA

config SYS_BOARD
	default "mocha"

config SYS_VENDOR
	default "lowrisc"

config SYS_CPU
	default "generic"

config SYS_CONFIG_NAME
	default "lowrisc-mocha"

config TEXT_BASE
	default 0x80000000 if TARGET_LOWRISC_MOCHA && !RISCV_SMODE
	default 0x80200000 if TARGET_LOWRISC_MOCHA && RISCV_SMODE

config BOARD_SPECIFIC_OPTIONS
	def_bool y
	select GENERIC_RISCV
	imply SERIAL
	imply GPIO
	imply SPI
	imply LOWRISC_ETH
	imply LOWRISC_OPENTITAN_UART
	imply LOWRISC_OPENTITAN_GPIO
	imply LOWRISC_OPENTITAN_SPI_HOST

endif
```

## configs/lowrisc_mocha_cheri_smode_defconfig
```kconfig
CONFIG_RISCV=y
CONFIG_ARCH_RV64I=y
CONFIG_RISCV_SMODE=y
# CONFIG_RISCV_PRIV_1_9 is not set
CONFIG_RISCV_ISA_ZCHERIPURECAP=y
CONFIG_RISCV_ISA_ZCHERIHYBRID=y
CONFIG_RISCV_ISA_ZCHERIPURECAP_ABI=y
CONFIG_BOOT_LINUX_KERNEL_IN_CAP_PTR_MODE=y
CONFIG_TARGET_LOWRISC_MOCHA=y
CONFIG_DEFAULT_DEVICE_TREE="lowrisc-mocha"
CONFIG_OF_BOARD=y
# CONFIG_OF_OMIT_DTB is not set
CONFIG_NR_DRAM_BANKS=1
CONFIG_SYS_LOAD_ADDR=0x80200000
CONFIG_HAS_CUSTOM_SYS_INIT_SP_ADDR=y
CONFIG_CUSTOM_SYS_INIT_SP_ADDR=0x80200000
CONFIG_USE_PREBOOT=y
CONFIG_PREBOOT="setenv fdt_addr ${fdtcontroladdr}; fdt addr ${fdtcontroladdr}; setenv script_addr 0x80100000; setenv bootcmd 'load mmc 0 ${script_addr} /boot.scr; source ${script_addr};'"
CONFIG_DM_GPIO=y
CONFIG_DM_SERIAL=y
CONFIG_DM_SPI=y
CONFIG_MMC=y
CONFIG_MMC_SPI=y
CONFIG_FS_EXT4=y
CONFIG_FS_FAT=y
# CONFIG_FS_EXFAT is not set
CONFIG_DOS_PARTITION=y
CONFIG_ISO_PARTITION=y
CONFIG_EFI_PARTITION=y
# CONFIG_EFI_LOADER is not set
CONFIG_SYS_PROMPT="(mocha) $ "
CONFIG_CMD_MMC=y
CONFIG_CMD_FS_GENERIC=y
CONFIG_CMD_BOOTDEV=y
CONFIG_CMD_BOOTFLOW=y
CONFIG_CMD_BOOTMETH=y
CONFIG_CMD_EXT4=y
CONFIG_CMD_CAT=y
CONFIG_CMD_CPU=y
CONFIG_CMD_GPIO=y
CONFIG_CMD_SBI=y
CONFIG_CMD_UFETCH=y
CONFIG_CMD_XXD=y
CONFIG_CMD_2048=y
# CONFIG_CMD_LZMADEC is not set
# CONFIG_CMD_UNLZ4 is not set
# CONFIG_CMD_UNZIP is not set
# CONFIG_CMD_LOADB is not set
# CONFIG_CMD_LOADS is not set
# CONFIG_CMD_ELF_BOOTVX is not set
# CONFIG_CMD_IMI is not set
# CONFIG_CMD_XIMG is not set
# CONFIG_TOOLS_KWBIMAGE is not set
# CONFIG_TOOLS_LIBCRYPTO is not set
```
